## sdkconfig.defaults
```kconfig
# -Wno-error (how can some submodule take over and break framework deps lol?)
#
# CONFIG_COMPILER_CXX_RTTI (cause I wanna!)

CONFIG_COMPILER_STACK_CHECK_MODE=STRONG

CONFIG_ESPTOOLPY_FLASHSIZE="4MB"
CONFIG_ENABLE_ARDUINO_DEPENDS=y
CONFIG_PARTITION_TABLE_FILENAME="partitions.csv"
CONFIG_COMPILER_CXX_EXCEPTIONS=y
CONFIG_COMPILER_CXX_RTTI=y
#only until sort so lib warnings off...
CONFIG_COMPILER_DISABLE_GCC8_WARNINGS=y

# for smooth:
# must be over 3k:
CONFIG_ESP_SYSTEM_EVENT_TASK_STACK_SIZE=4096
# 1ms per tick (1000hz is maximum...)
CONFIG_FREERTOS_HZ=1000
# CONFIG_ESP_MAIN_TASK_STACK_SIZE=8000
# CONFIG_MAIN_TASK_STACK_SIZE=8000

CONFIG_ESP32_PANIC_GDBSTUB=y
CONFIG_ESP32_DEBUG_STUBS_ENABLE=y


# CONFIG_MONITOR_BAUD=230400
# CONFIG_ESP_CONSOLE_UART_BAUDRATE=230400
# CONFIG_ESPTOOLPY_MONITOR_BAUD=230400
# CONFIG_MONITOR_BAUD_230400B=y
CONFIG_MONITOR_BAUD_115200B=y
CONFIG_MONITOR_BAUD=115200
CONFIG_ESP_CONSOLE_UART_BAUDRATE=115200
CONFIG_ESPTOOLPY_MONITOR_BAUD=115200

# threading cpu stats, needs further defines..
# Select Enable FreeRTOS to collect run time stats under
# Component Config > FreeRTOS (this should be enabled in the example by default)
# Choose the clock source for run time stats configured under
# Component Config > FreeRTOS. The esp_timer should be selected be default. This option will affect the time unit resolution in which the statistics are measured with respect to.
CONFIG_FREERTOS_USE_TRACE_FACILITY=y
CONFIG_FREERTOS_GENERATE_RUN_TIME_STATS=y

CONFIG_LOG_COLORS=y

# SMOOTH_ENABLE_ASAN=y # for linux

# scaled back somehwat values from iperf example recommended https://github.com/espressif/esp-idf/issues/3646, something arduino gimped wifi buffers...
# also https://github.com/espressif/esp-idf/issues/3663
# ( 10, 32, 32, 6, 6 there)
CONFIG_ESP32_WIFI_STATIC_RX_BUFFER_NUM=16
CONFIG_ESP32_WIFI_DYNAMIC_RX_BUFFER_NUM=64
CONFIG_ESP32_WIFI_DYNAMIC_TX_BUFFER_NUM=64
CONFIG_ESP32_WIFI_TX_BA_WIN=32
CONFIG_ESP32_WIFI_RX_BA_WIN=32
# (5744, 5744, 6, 16, 16)
CONFIG_LWIP_TCP_SND_BUF_DEFAULT=16384
CONFIG_LWIP_TCP_WND_DEFAULT=16384
CONFIG_LWIP_TCP_RECVMBOX_SIZE=32
CONFIG_LWIP_UDP_RECVMBOX_SIZE=32
CONFIG_LWIP_TCPIP_RECVMBOX_SIZE=64
```
